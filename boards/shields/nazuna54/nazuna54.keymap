
#include <behaviors.dtsi>
#include <dt-bindings/zmk/keys.h>
#include "zmk-helpers/helper.h"


#define ZMK_POINTING_DEFAULT_MOVE_VAL 600  // default: 600
#define ZMK_POINTING_DEFAULT_SCRL_VAL 10    // default: 10

#include <dt-bindings/zmk/pointing.h>
#include <dt-bindings/zmk/mouse.h>

#define MBASE 0
#define WBASE 1
#define MLOWER 2
#define WLOWER 3
#define MRAISE 4
#define WRAISE 5
#define MADJUST 6
#define WADJUST 7
#define DEVICE 8
#define MODE 10

&mt {
    tapping-term-ms = <180>;
};
&lt {
    tapping-term-ms = <180>;
};

ZMK_HOLD_TAP(hml,
    flavor = "balanced";
    tapping-term-ms = <280>;
    require-prior-idle-ms = <150>;
    quick-tap-ms = <175>;
    hold-trigger-key-positions = <
         7  8  9 10 11 12 13
        21 22 23 24 25 26 27
           34 35 36 37 38 39
        47 48 49 50 51 52 53
    >;
    hold-trigger-on-release;
    bindings = <&kp>, <&kp>;
)

ZMK_HOLD_TAP(hmr,
    flavor = "balanced";
    tapping-term-ms = <280>;
    require-prior-idle-ms = <150>;
    quick-tap-ms = <175>;
    hold-trigger-key-positions = <
         0  1  2  3  4  5  6
        14 15 16 17 18 19 20
        28 29 30 31 32 33
        40 41 42 43 44 45 46
    >;
    hold-trigger-on-release;
    bindings = <&kp>, <&kp>;
)

ZMK_CONDITIONAL_LAYER(tri_layer_mac, MLOWER MRAISE, MADJUST)
ZMK_CONDITIONAL_LAYER(tri_layer_win, WLOWER WRAISE, WADJUST)

ZMK_TAP_DANCE(pst_mac,
    tapping-term-ms = <180>;
    bindings = <&kp LG(V)>, <&kp LS(LG(V))>;
)

ZMK_TAP_DANCE(pst_win,
    tapping-term-ms = <180>;
    bindings = <&kp LC(V)>, <&kp LS(LC(V))>;
)

ZMK_TAP_DANCE(undo_mac,
    tapping-term-ms = <180>;
    bindings = <&kp LC(Z)>, <&kp LS(LC(Z))>;
)
ZMK_TAP_DANCE(undo_win,
    tapping-term-ms = <180>;
    bindings = <&kp LC(Z)>, <&kp LS(LC(Z))>;
)

/ {
    keymap {
        compatible = "zmk,keymap";

        layer_0 {
            display-name = "Base Mac";
            bindings =<
                &kp ESC   &kp Q    &kp W     &kp F     &kp P    &kp B             &kp LS(LC(TAB))       &kp LS(LG(TAB))  &kp J   &kp L    &kp U     &kp Y   &kp SQT   &kp EQL
                &kp TAB   &kp A    &kp R     &kp S     &kp T    &kp G             &kp LC(TAB)           &kp LG(TAB)      &kp M   &kp N    &kp E     &kp I   &kp O     &kp MINUS
                &kp LSHFT &kp Z    &kp X     &kp C     &kp D    &kp V                                                    &kp K   &kp H    &kp COMMA &kp DOT &kp SLASH &kp SEMI
                &mo MODE     &none    &none     &kp LCTRL &kp LALT &mt LGUI SPACE &lt MLOWER LANG1        &lt MRAISE LANG2 &kp RET &kp BSPC &none     &none   &none     &none
            >;
        };

        layer_1 {
            display-name = "Base Windows";
            bindings =<
                &kp ESC   &kp Q    &kp W     &kp F    &kp P    &kp B            &kp LS(LC(TAB))       &kp LS(LA(TAB)) &kp J          &kp L    &kp U     &kp Y   &kp SQT   &kp EQL
                &kp TAB   &kp A    &kp R     &kp S    &kp T    &kp G            &kp LC(TAB)           &kp LA(TAB)     &kp M          &kp N    &kp E     &kp I   &kp O     &kp MINUS
                &kp LSHFT &kp Z    &kp X     &kp C    &kp D    &kp V                                            &kp K          &kp H    &kp COMMA &kp DOT &kp SLASH &kp SEMI
                &none     &kp CAPS &kp LCTRL &kp LALT &kp LGUI &lt WLOWER SPACE &kp LANG1             &kp LANG2 &lt WRAISE RET &kp BSPC &none     &none   &none     &none
            >;
        };

        layer_2 {
            display-name = "Lower Mac";
            bindings =<
                &kp GRAVE &kp N1    &kp N2    &kp N3    &kp N4     &kp N5 &trans   &trans &kp N6 &kp N7 &kp N8 &kp N9 &kp N0 &kp BSLH
				&trans    &kp LCTRL &kp LALT  &kp LCMD  &kp LSHIFT &trans &trans   &trans &kp LEFT &kp DOWN &kp UP &kp RIGHT &trans &trans
				&trans    &undo_mac &kp LG(X) &kp LG(C) &pst_mac   &trans                 &kp HOME &kp PG_DN &kp PG_UP &kp END &trans &trans
				&trans    &trans    &trans    &trans    &trans     &trans &trans   &trans &trans &trans &trans &trans &trans &trans
            >;
        };
        layer_3 {
            display-name = "Lower Windows";
            bindings =<
                &kp GRAVE &kp N1    &kp N2    &kp N3    &kp N4     &kp N5 &trans   &trans &kp N6 &kp N7 &kp N8 &kp N9 &kp N0 &kp BSLH
				&trans    &kp LCTRL &kp LALT  &kp LCMD  &kp LSHIFT &trans &trans   &trans &kp LEFT &kp DOWN &kp UP &kp RIGHT &trans &trans
				&trans    &undo_win &kp LC(X) &kp LC(C) &pst_win   &trans                 &kp HOME &kp PG_DN &kp PG_UP &kp END &trans &trans
				&trans    &trans    &trans    &trans    &trans     &trans &trans   &trans &trans &trans &trans &trans &trans &trans
            >;
        };

        layer_4 {
            display-name = "Raise Mac";
            bindings =<
                &kp TILDE &kp EXCL &kp AT &kp HASH &kp DLLR &kp PRCNT &trans   &trans &kp CARET &kp AMPS &kp STAR &kp LPAR &kp RPAR &kp PIPE 
				&trans    &trans   &trans &trans   &trans   &trans    &trans   &trans &trans &trans &trans &trans &trans &trans
				&trans    &trans   &trans &trans   &trans   &trans                    &trans &trans &trans &trans &trans &trans
				&trans    &trans   &trans &trans   &trans   &trans    &trans   &trans &trans &trans &trans &trans &trans &trans
            >;
        };

        layer_5 {
            display-name = "Raise Windows";
            bindings =<
                &trans &trans &trans &trans &trans &trans &trans   &trans &trans &trans &trans &trans &trans &trans
				&trans &trans &trans &trans &trans &trans &trans   &trans &trans &trans &trans &trans &trans &trans
				&trans &trans &trans &trans &trans &trans                 &trans &trans &trans &trans &trans &trans
				&trans &trans &trans &trans &trans &trans &trans   &trans &trans &trans &trans &trans &trans &trans
            >;
        };
        layer_6 {
            display-name = "Adjust Mac";
            bindings =<
                &trans &trans &trans &trans &trans &trans &trans   &trans &trans &trans &trans &trans &trans &trans
				&trans &trans &trans &trans &trans &trans &trans   &trans &trans &trans &trans &trans &trans &trans
				&trans &trans &trans &trans &trans &trans                 &trans &trans &trans &trans &trans &trans
				&trans &trans &trans &trans &trans &trans &trans   &trans &trans &trans &trans &trans &trans &trans
            >;
        };
        layer_7 {
            display-name = "Adjust Windows";
            bindings =<
                &trans &trans &trans &trans &trans &trans &trans   &trans &trans &trans &trans &trans &trans &trans
				&trans &trans &trans &trans &trans &trans &trans   &trans &trans &trans &trans &trans &trans &trans
				&trans &trans &trans &trans &trans &trans                 &trans &trans &trans &trans &trans &trans
				&trans &trans &trans &trans &trans &trans &trans   &trans &trans &trans &trans &trans &trans &trans
            >;
        };
        layer_8 {
            display-name = "Navigation";
            bindings =<
                &trans &trans &trans         &trans         &trans          &trans &trans        &trans &trans   &trans    &trans    &trans    &trans &trans
				&trans &trans &mmv MOVE_LEFT &mmv MOVE_UP   &mmv MOVE_RIGHT &trans &trans        &trans &mkp MB4 &mkp LCLK &mkp MCLK &mkp RCLK &trans &trans
				&trans &trans &trans         &mmv MOVE_DOWN &trans          &trans                      &mkp MB5 &trans    &trans    &trans    &trans &trans
				&trans &trans &trans         &trans         &trans          &trans &trans        &trans &trans   &trans    &trans    &trans    &trans &trans
            >;
        };
        layer_9 {
            display-name = "Device";
            bindings =<
                &trans &kp C_BRI_DN &kp C_BRI_UP &trans &trans &trans &trans   &trans &kp C_PREV &kp C_PP &kp C_NEXT &kp C_MUTE &kp C_VOL_DN &kp C_VOL_UP
				&trans &trans &trans &trans &trans &trans &trans   &trans &trans &trans &trans &trans &trans &trans
				&trans &trans &trans &trans &trans &trans                 &trans &trans &trans &trans &trans &trans
				&trans &trans &trans &trans &trans &trans &trans   &trans &trans &trans &trans &trans &trans &trans
            >;
        };
        layer_10 {
            display-name = "MODE";
            bindings =<
                &trans &trans &trans &trans &trans &trans &trans   &trans &trans &trans &trans &trans &trans &trans
				&trans &trans &trans &trans &trans &trans &trans   &trans &trans &trans &trans &trans &trans &trans
				&trans &trans &trans &trans &trans &trans                 &trans &trans &trans &trans &trans &trans
				&trans &trans &trans &to WBASE &trans &trans &trans   &trans &trans &trans &trans &trans &trans &trans
            >;
        };
    };
};
