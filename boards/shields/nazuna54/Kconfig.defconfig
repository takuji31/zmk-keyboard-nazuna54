## boards/shields/nazuna54/Kconfig.defconfig
```kconfig
if SHIELD_NAZUNA54_DONGLE
config ZMK_KEYBOARD_NAME
    default "nazuna54"
config ZMK_SPLIT_ROLE_CENTRAL
    default y
config ZMK_SPLIT_BLE_CENTRAL_PERIPHERALS
    default 2
config BT_MAX_CONN
    default 7
config BT_MAX_PAIRED
    default 7
endif

if SHIELD_NAZUNA54_LEFT || SHIELD_NAZUNA54_RIGHT || SHIELD_NAZUNA54_DONGLE
config ZMK_SPLIT
    default y
endif
```

## boards/shields/nazuna54/Kconfig.shield
```kconfig
config SHIELD_NAZUNA54_LEFT
    def_bool $(shields_list_contains,nazuna54_left)
config SHIELD_NAZUNA54_RIGHT
    def_bool $(shields_list_contains,nazuna54_right)
```
